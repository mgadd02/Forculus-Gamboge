## CMakeLists.txt
```
cmake_minimum_required(VERSION 3.20.0)

find_package(Zephyr)
project(admin_node)

# Collect all files in apps/prac2/src
FILE(GLOB app_sources src/*.c)

# Collect all files in mylib 
FILE(GLOB lib_sources lib/*.c)

# Tell CMake to build with the app and lib sources
target_sources(app PRIVATE ${app_sources} ${lib_sources})

# Tell CMake where our header files are
target_include_directories(app PRIVATE ./include)
```

## prj.conf
```kconfig
############## Networking and MQTT ##############
# General networking
CONFIG_NETWORKING=y
CONFIG_NET_IPV4=y
CONFIG_NET_TCP=y
CONFIG_NET_UDP=y
CONFIG_NET_SOCKETS=y

# Use Zephyr-style socket names (zsock_*) — do NOT enable POSIX_NAMES
# CONFIG_NET_SOCKETS_POSIX_NAMES=n

# MQTT support (no TLS for simplicity)
CONFIG_MQTT_LIB=y
# CONFIG_MQTT_LIB_TLS=n

# Enable Wi-Fi
CONFIG_WIFI=y
CONFIG_WIFI_ESP32=y
CONFIG_WIFI_INIT_PRIORITY=90

# DHCP
CONFIG_NET_DHCPV4=y

# Network auto-init (optional; enables interface startup automatically)
# CONFIG_NET_CONFIG_AUTO_INIT=y

# Enable hostname support
CONFIG_NET_HOSTNAME_ENABLE=y

# Connection manager (helps with Wi-Fi)
CONFIG_NET_CONNECTION_MANAGER=y

# Logging
CONFIG_LOG=y
CONFIG_NET_LOG=y
# CONFIG_NET_DHCPV4_LOG_LEVEL_DBG=y
# CONFIG_MQTT_LOG_LEVEL_DBG=y

# JSON support (if needed for message parsing)
# CONFIG_JSON_LIBRARY=y

# Increase buffer sizes (safe defaults)
# CONFIG_MAIN_STACK_SIZE=4096
CONFIG_SYSTEM_WORKQUEUE_STACK_SIZE=1024
# ^^ Possibly change...
CONFIG_NET_PKT_RX_COUNT=4
CONFIG_NET_PKT_TX_COUNT=4
CONFIG_NET_BUF_RX_COUNT=8
CONFIG_NET_BUF_TX_COUNT=8
CONFIG_NET_CONTEXT_NET_PKT_POOL=y

# Optional: POSIX compatibility (basic)
CONFIG_POSIX_API=y

CONFIG_NET_L2_ETHERNET=y
CONFIG_ETH_INIT_PRIORITY=80

CONFIG_ESP32_USE_UNSUPPORTED_REVISION=y

CONFIG_DNS_RESOLVER=y

CONFIG_HEAP_MEM_POOL_SIZE=20480

CONFIG_LOG_DEFAULT_LEVEL=3  
# 0=none, 1=err, 2=warn, 3=inf, 4=dbg

############ LVGL Display ###############

CONFIG_LV_Z_MEM_POOL_SIZE=32768
CONFIG_LV_Z_SHELL=y
# CONFIG_MAIN_STACK_SIZE=4096

CONFIG_DISPLAY=y
CONFIG_DISPLAY_LOG_LEVEL_ERR=y

# CONFIG_LOG=y
CONFIG_SHELL=y

CONFIG_LVGL=y
CONFIG_LV_USE_LOG=y
CONFIG_LV_USE_LABEL=y
CONFIG_LV_USE_ARC=y
CONFIG_LV_USE_MONKEY=y
CONFIG_LV_FONT_MONTSERRAT_14=y
```

## src/main.c
```c
// #include "mqtt_client.h"

// int main(void) {
// 	// Start the MQTT client
// 	if (start_mqtt_client() != 0) {
// 		return -1; // Error starting MQTT client
// 	}

// 	// Main loop can be added here if needed
// 	while (1) {
// 		// Process MQTT events or other tasks
// 		// k_sleep(K_SECONDS(1)); // Sleep to avoid busy-waiting
// 	}

// 	return 0; // Should never reach here
// }

#include "lvgl_display.h"
#include "mqtt_client.h"

#include <zephyr/kernel.h>

/* scheduling parameters */
#define STACKSIZE 				4096
#define SMALL_STACKSIZE 		2048

#define PRIORITY 				7

K_THREAD_DEFINE(lvgl_display, STACKSIZE, run_lvgl_display, NULL, NULL, NULL, PRIORITY, 0, 0);
// K_THREAD_DEFINE(bluetooth_sender0_id, STACKSIZE, bluetooth_sender0, NULL, NULL, NULL, PRIORITY, 0, 0);

K_THREAD_DEFINE(mqtt_client, SMALL_STACKSIZE, start_mqtt_client, NULL, NULL, NULL, PRIORITY, 0, 0);
```

## include/esp32_wifi_connect.h
```c
#ifndef ESP32_WIFI_CONNECT_H
#define ESP32_WIFI_CONNECT_H


extern int start_wifi(void);

#endif // ESP32_WIFI_CONNECT_H
```

## include/lvgl_display.h
```c
#ifndef LVGL_DISPLAY_H
#define LVGL_DISPLAY_H

extern int run_lvgl_display(void);

#endif // LVGL_DISPLAY_H
```

## include/mqtt_client.h
```c
#ifndef MQTT_CLIENT_H
#define MQTT_CLIENT_H

#include <stdbool.h>


/** MQTT connection timeouts */
#define MSECS_NET_POLL_TIMEOUT	5000
#define MSECS_WAIT_RECONNECT	1000

#define MQTT_TOPIC "topic/test/esp32_sub"
#define CLIENT_ID "esp32_sub"

// #define MQTT_BROKER_ADDR "f466895c2a554c708ecd3d675b4db272.s1.eu.hivemq.cloud"
// #define MQTT_BROKER_PORT 8883

// #define MQTT_USERNAME "slarm"
// #define MQTT_PASSWORD "Slarmiscool1"

#define MQTT_BROKER_ADDR "broker.hivemq.com"
#define MQTT_BROKER_PORT 1883

#define MQTT_USERNAME NULL
#define MQTT_PASSWORD NULL

extern int start_mqtt_client(void);

extern struct k_fifo mqtt_lvgl_fifo;  // FIFO for MQTT data

typedef struct {
    void *fifo_reserved;  // Needed by Zephyr FIFO (must be first)
    bool open;
    bool locked;
    bool motion_detected;
    bool face_validated;
    bool pin_validated;
    bool new_attempt;
    char face_name[15];  // Assuming a max length for the face name
    char temperature[10];  // Assuming a max length for temperature
    char humidity[10];  // Assuming a max length for humidity
    char air_quality[10];  // Assuming a max length for air quality
} mqtt_lvgl_data_t;

#endif // MQTT_CONFIG_H
```
