## CMakeLists.txt
```
cmake_minimum_required(VERSION 3.20.0)
find_package(Zephyr REQUIRED HINTS $ENV{ZEPHYR_BASE})
project(display_node)

# Local source files
file(GLOB local_sources
    ${CMAKE_CURRENT_SOURCE_DIR}/src/*.c
    ${CMAKE_CURRENT_SOURCE_DIR}/lib/*.c
)

# Global source files
file(GLOB global_sources
    ${CMAKE_CURRENT_SOURCE_DIR}/../lib/rxBluetooth.c
)

# Combine all sources
target_sources(app PRIVATE ${local_sources} ${global_sources})

# Include both local and global headers
target_include_directories(app PRIVATE
    ${CMAKE_CURRENT_SOURCE_DIR}/include
    ${CMAKE_CURRENT_SOURCE_DIR}/../include
)
```

## prj.conf
```kconfig
CONFIG_GPIO=y
CONFIG_PRINTK=y

CONFIG_MAIN_STACK_SIZE=4096
CONFIG_SYSTEM_WORKQUEUE_STACK_SIZE=2048
CONFIG_HEAP_MEM_POOL_SIZE=4096

# Bluetooth
CONFIG_BT=y
CONFIG_BT_DEVICE_NAME="display_node"
CONFIG_BT_PERIPHERAL=y
CONFIG_BT_SMP=y
CONFIG_BT_BONDABLE=y
CONFIG_BT_PRIVACY=y
CONFIG_BT_DEVICE_NAME_DYNAMIC=n
CONFIG_BT_DEVICE_APPEARANCE=0
CONFIG_BT_GATT_DYNAMIC_DB=y


CONFIG_BT_MAX_CONN=1

CONFIG_PICOLIBC_USE_MODULE=y
```

## src/main.c
```c
#include <zephyr/kernel.h>
#include <zephyr/device.h>
#include "displayBluetooth.h"
#include <string.h>
/* scheduling parameters */
#define STACKSIZE               2048
#define PRIORITY 				7
#define PRIORITY_SENSOR			3

int main(void)
{
    printk("Display node started\n");
    return 0;
}
K_THREAD_DEFINE(bluetooth_receiver0_id, STACKSIZE, bluetooth_receiver0, NULL, NULL, NULL, PRIORITY, 0, 0);
```

## include/displayBluetooth.h
```c
#ifndef DISPLAYBLUETOOTH_H
#define DISPLAYBLUETOOTH_H

void bluetooth_receiver0(void);


#endif // DISPLAYBLUETOOTH_H
```
